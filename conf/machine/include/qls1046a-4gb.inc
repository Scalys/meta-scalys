## conf/machine/include/qls1046a-4gb.inc
```bitbake
#@TYPE: Machine
#@NAME: Teledyne QLS1046A-4GB on Scalys development board
#@SOC: LSCH2
#@DESCRIPTION: Machine configuration for running LS1046A in 64-bit mode
#@MAINTAINER: Zhenhua Luo <zhenhua.luo@nxp.com>
#@MAINTAINER: opensource@scalys.com

MACHINEOVERRIDES =. "fsl-lsch2:ls1046a:"

require conf/machine/include/qoriq-arm64.inc
require conf/machine/include/arm/arch-arm64.inc

MACHINE_FEATURES += "optee"

KERNEL_CLASSES  = " kernel-fitimage "
KERNEL_IMAGETYPES = "fitImage"

UBOOT_DTB_LOADADDRESS = "0x90000000"
UBOOT_ENTRYPOINT = "0x80080000"

UBOOT_CONFIG ??= "nor sdhc nor_xfi sdhc_xfi"
UBOOT_CONFIG[nor] = "qls1046a_4gb_ifc_nor_defconfig"
UBOOT_CONFIG[sdhc] = "qls1046a_4gb_sdcard_defconfig"
UBOOT_CONFIG[nor_xfi] = "qls1046a_4gb_ifc_nor_xfi_defconfig"
UBOOT_CONFIG[sdhc_xfi] = "qls1046a_4gb_sdcard_xfi_defconfig"

KERNEL_DEVICETREE ?= "\
    freescale/qls1046a-4gb.dtb \
    freescale/qls1046a-4gb-xfi.dtb \
    freescale/qls1046a-4gb-sdk.dtb \
    freescale/qls1046a-4gb-sdk-xfi.dtb \
"
KERNEL_DEFCONFIG ?= "defconfig"

SERIAL_CONSOLES ?= "115200;ttyS0 115200;ttyAMA0 115200;ttyLP0"
SERIAL_CONSOLES_CHECK ?= "${SERIAL_CONSOLES}"

RCWSD ?= "RR_SSSSPPPP_3333_8888/rcw_1600_sdboot"
RCWNOR ?= "RR_SSSSPPPP_3333_8888/rcw_1600_ifc_nor"
RCWSDXFI ?= "RR_FFSSPPPP_1133_8888/rcw_1600_sdboot_xfi"
RCWNORXFI ?= "RR_FFSSPPPP_1133_8888/rcw_1600_ifc_nor_xfi"
BOOTTYPE="nor sd nor_xfi sd_xfi"

FMAN_UCODE ?= "fsl_fman_ucode_ls1046_r1.0_106_4_18.bin"

EXTRA_IMAGEDEPENDS += "fm-ucode rcw qoriq-atf qe-ucode ls2-phy"
#DISTRO_FEATURES:append = " optee"
USE_VT = "0"

# Images types generated for this machine
IMAGE_FSTYPES:append = " tar.bz2 ubifs ubi wic"

# mkfs.ubi options:
# Find parameter values on target with `ubinfo -a`
#    -m, --min-io-size=SIZE   minimum I/O unit size
#    -e, --leb-size=SIZE      logical erase block size
#    -c, --max-leb-cnt=COUNT  maximum logical erase block count
MKUBIFS_ARGS = "--space-fixup -m 2048 -e 124KiB -c 10000"

# ubinize options:
# Find parameter values on target with `mtdinfo -a`
# -p, --peb-size=<bytes>       size of the physical eraseblock of the flash
# -m, --min-io-size=<bytes>    minimum input/output unit size of the flash in bytes
# -s, --sub-page-size=<bytes>  minimum input/output unit used for UBI headers
UBINIZE_ARGS = "-m 2048 -p 128KiB -s 2048"
UBI_VOLNAME = "rootfs"

WKS_FILES ?= "${MACHINE}-sdimg.wks"

MACHINE_ESSENTIAL_EXTRA_RRECOMMENDS:append = " \
    kernel-image-fitimage \
"
```

## conf/machine/qls1046-4gb-dkb.conf
```bitbake
#@TYPE: Machine
#@NAME: Teledyne QLS1046A-4GB-DKB on Scalys development board
#@SOC: LSCH2
#@DESCRIPTION: Machine configuration for running LS1046A in 64-bit mode
#@MAINTAINER: Zhenhua Luo <zhenhua.luo@nxp.com>
#@MAINTAINER: opensource@scalys.com

require conf/machine/include/qls1046a-4gb.inc
```

## conf/machine/qls1046a-4gb.conf
```bitbake
#@TYPE: Machine
#@NAME: Teledyne QLS1046A-4GB on Scalys development board
#@SOC: LSCH2
#@DESCRIPTION: Machine configuration for running LS1046A in 64-bit mode
#@MAINTAINER: opensource@scalys.com

MACHINEOVERRIDES =. "fsl-lsch2:ls1046a:"

require conf/machine/include/qoriq-arm64.inc
require conf/machine/include/arm/arch-arm64.inc

KERNEL_CLASSES  = " kernel-fitimage "
KERNEL_IMAGETYPES = "fitImage"

UBOOT_DTB_LOADADDRESS = "0x90000000"
UBOOT_ENTRYPOINT = "0x80080000"

UBOOT_CONFIG ??= "nor sdhc nor_xfi sdhc_xfi"
UBOOT_CONFIG[sdhc] = "qls1046a_4gb_sdcard_defconfig,,u-boot-with-spl-pbl.bin"
UBOOT_CONFIG[nor] = "qls1046a_4gb_ifc_nor_defconfig,,u-boot-with-spl-pbl.bin"
UBOOT_CONFIG[sdhc_xfi] = "qls1046a_4gb_sdcard_xfi_defconfig,,u-boot-with-spl-pbl.bin"
UBOOT_CONFIG[nor_xfi] = "qls1046a_4gb_ifc_nor_xfi_defconfig,,u-boot-with-spl-pbl.bin"

KERNEL_DEVICETREE ?= "\
    freescale/qls1046a-4gb-sdk.dtb \
    freescale/qls1046a-4gb-sdk-xfi.dtb \
"
# Additional .config fragments are added in the kernel recipe
KERNEL_DEFCONFIG ?= "defconfig"

SERIAL_CONSOLES ?= "115200;ttyS0 115200;ttyAMA0 115200;ttyLP0"
SERIAL_CONSOLES_CHECK ?= "${SERIAL_CONSOLES}"

EXTRA_IMAGEDEPENDS += "fm-ucode ls2-phy"
USE_VT = "0"

# Images types generated for this machine
IMAGE_FSTYPES = "tar.bz2 ubifs ubi"

# Undo UBI configuration in /meta-qoriq-demos/conf/distro/fsl-qoriq.conf
OVERRIDES =. "ubiargs-override:"
# mkfs.ubi options: 
# Find parameter values on target with `ubinfo -a`
#    -m, --min-io-size=SIZE   minimum I/O unit size
#    -e, --leb-size=SIZE      logical erase block size
#    -c, --max-leb-cnt=COUNT  maximum logical erase block count
MKUBIFS_ARGS_ubiargs-override ?= "--space-fixup -m 2048 -e 124KiB -c 10000"

# ubinize options:
# Find parameter values on target with `mtdinfo -a`
# -p, --peb-size=<bytes>       size of the physical eraseblock of the flash
# -m, --min-io-size=<bytes>    minimum input/output unit size of the flash in bytes
# -s, --sub-page-size=<bytes>  minimum input/output unit used for UBI headers
UBINIZE_ARGS_ubiargs-override ?= "-m 2048 -p 128KiB -s 2048"
UBI_VOLNAME = "rootfs"

# Hide (yet) unsupported recipes for this board
BBMASK += "/meta-qoriq-demos/recipes-bsp/edgescale-bootstrap/edgescale-bootstrap.bb"
BBMASK += "/meta-qoriq-demos/recipes-bsp/secure-boot/sequre-boot-qoriq.bb"

MACHINE_FEATURES += "optee"
OPTEEMACHINE = "ls1046ardb"
```

## conf/machine/trustbox-edge-101.conf
```bitbake
#@TYPE: Machine
#@NAME: Scalys TrustBox Edge 101
#@SOC: LSCH2
#@DESCRIPTION: Machine configuration for running LS1012A in 64-bit mode
#@MAINTAINER: Dmitry Lavnikevich <dmitry.lavnikevich@edality.by>

MACHINEOVERRIDES =. "fsl-lsch2:ls1012a:"

require conf/machine/include/qoriq-arm64.inc
require conf/machine/include/arm/arch-arm64.inc

MACHINE_FEATURES += "optee"

KERNEL_CLASSES  = " kernel-fitimage "
KERNEL_IMAGETYPES = "fitImage"

KERNEL_MODULE_AUTOLOAD += "rtl8723bu"
MACHINE_EXTRA_RRECOMMENDS += "kernel-module-8723bu kernel-firmware-rtl8723bu-nic kernel-firmware-rtl8723bu-bt"

UBOOT_DTB_LOADADDRESS = "0x90000000"
UBOOT_ENTRYPOINT = "0x80080000"

UBOOT_CONFIG ??= "tfa-secure-boot tfa"
# UBOOT_CONFIG[tfa] = "tbe101_tfa_defconfig,,u-boot-dtb.bin"
# UBOOT_CONFIG[tfa-secure-boot] = "tbe101_tfa_SECURE_BOOT_defconfig,,u-boot-dtb.bin"

UBOOT_CONFIG[tfa] = "trustbox_tfa_defconfig,,u-boot-dtb.bin"
UBOOT_CONFIG[tfa-secure-boot] = "trustbox_tfa_SECURE_BOOT_defconfig,,u-boot-dtb.bin"

RCWQSPI ?= "N_SSNH_3308/rcw_1000_default"
RCWQSPISEC ?= "N_SSNH_3308/rcw_1000_default"

KERNEL_DEVICETREE ?= "freescale/trustbox.dtb"
KERNEL_DEFCONFIG ?= "defconfig"

EXTRA_IMAGEDEPENDS += "ppfe-firmware rcw atf"
USE_VT = "0"

DISTRO_FEATURES_append = " systemd virtualization optee"
DISTRO_FEATURES_BACKFILL_CONSIDERED += "sysvinit"
VIRTUAL-RUNTIME_init_manager = "systemd"
VIRTUAL-RUNTIME_initscripts = "systemd-compat-units"
```

## conf/machine/trustbox.conf
```bitbake
#@TYPE: Machine
#@NAME: Scalys TrustBox
#@SOC: LSCH2
#@DESCRIPTION: Machine configuration for running LS1012A in 64-bit mode
#@MAINTAINER: Dmitry Lavnikevich <dmitry.lavnikevich@edality.by>

MACHINEOVERRIDES =. "fsl-lsch2:ls1012a:"

require conf/machine/include/qoriq-arm64.inc
require conf/machine/include/arm/arch-arm64.inc

SOC_FAMILY = "fsl-lsch2:ls1012a"

KERNEL_DEVICETREE ?= "freescale/trustbox.dtb"
KERNEL_DEFCONFIG ?= "defconfig"
KERNEL_IMAGETYPE = "Image.gz"

DTB_LOAD = "0x90000000"
UBOOT_ENTRYPOINT = "0x80080000"
UBOOT_LOADADDRESS = "0x80080000"

SERIAL_CONSOLES ?= "115200;ttyS0 115200;ttyAMA0"
SERIAL_CONSOLES_CHECK ?= "${SERIAL_CONSOLES}"

KERNEL_MODULE_AUTOLOAD += "rtl8723bu"
MACHINE_EXTRA_RRECOMMENDS += "kernel-module-8723bu kernel-firmware-rtl8723bu-nic kernel-firmware-rtl8723bu-bt"

MKUBIFS_ARGS = "--min-io-size 1 --leb-size 262016 --max-leb-cnt 245"
UBINIZE_ARGS = "--min-io-size 1 --peb-size 262144 --sub-page-size 1"
UBI_VOLNAME = "boot"

DISTRO_FEATURES_append = " systemd virtualization"
DISTRO_FEATURES_BACKFILL_CONSIDERED += "sysvinit"
VIRTUAL-RUNTIME_init_manager = "systemd"
VIRTUAL-RUNTIME_initscripts = "systemd-compat-units"

PREFERRED_PROVIDER_virtual/bootloader = "u-boot-lsdk"
PREFERRED_PROVIDER_u-boot = "u-boot-lsdk"
PREFERRED_PROVIDER_u-boot-fw-utils = "u-boot-lsdk-fw-utils"
UBOOT_CONFIG ??= "sata"
UBOOT_CONFIG[sata] = "trustbox_qspi_config,,u-boot-with-spl-pbl.bin"

USE_VT = "0"
```

## wic/qls1046-4gb-dkb-sdimg.wks
```
# short-description: Create SD card image with a boot partition
# long-description:
# Create an image that can be written onto a SD card using dd for use
# with QLS1046-4GB board.
# It uses u-boot.
#
# The disk layout used is:
#  - ----- ----------- ------------ --------------------
# | | PBL | FIP UBOOT | FMAN_UCODE |    rootfs          |
#  - ----- ----------- ------------ --------------------
# ^ ^     ^           ^
# | |     |           |
# 0 4kiB  1MiB        3MiB
#
part PBL --source rawcopy --sourceparams="file=atf/bl2_sd.pbl" --no-table --align 4
part FIP --source rawcopy --sourceparams="file=atf/fip_uboot_sd.bin" --no-table --align 1024
part FIP --source rawcopy --sourceparams="file=fsl_fman_ucode_ls1046_r1.0_106_4_18.bin" --no-table --align 9216
part / --source rootfs --fstype=ext4 --label rootfs --align 16384

bootloader --ptable msdos
```

## wic/trustbox-edge-101-sdimg.wks
```
part / --source rootfs --fstype=ext4 --label root --align 4096

bootloader --ptable gpt
```
